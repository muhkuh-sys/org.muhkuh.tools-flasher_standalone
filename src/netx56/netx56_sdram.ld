MEMORY
{
	ASSERT_EMPTY(rwx)  : ORIGIN = 0x00000000, LENGTH = 0

	IOVECTORS(rx)      : ORIGIN = 0x08000100, LENGTH = 0x00000010
	PRG_RAM(rwx)       : ORIGIN = 0x80000000, LENGTH = 0x00800000  /* ext. SDRAM */
}

INCLUDE src/netx.ld
